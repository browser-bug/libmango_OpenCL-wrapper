## Kconfig
```kconfig
################################################################################
# Platform Configuration
################################################################################


comment "Target architectures"

config LIBMANGO_GN
  bool "General-Purpose Node Emulation (GN)"
  default n

config LIBMANGO_PEAK
  bool "PEAK processor"
  depends on ! LIBMANGO_GN
  default y

config LIBMANGO_NUPLUS
  bool "NU+ processor"
  depends on ! LIBMANGO_GN
  default n


comment  "Building options"

config LIBMANGO_PROFILING_MODE
  bool "Profiling mode"
  default n
  ---help---
  Enable the profiling mode to collect data from the MANGO performance counters.

config LIBMANGO_NR_CORES_MAX
  int "Number of cores per processing unit"
  depends on LIBMANGO_PROFILING_MODE
  default 2
  ---help---
  Specify the max number of cores included in the platform processing units.
```
